## src/modules/mc_lqt_control/Kconfig
```kconfig
menuconfig MODULES_MC_LQT_CONTROL
	bool "mc_lqt_control"
	default n
	---help---
		Enable support for mc_lqt_control

menuconfig USER_LQT_CONTROL
	bool "mc_lqt_control running as userspace module"
	default y
	depends on BOARD_PROTECTED && MODULES_MC_LQT_CONTROL
	---help---
		Put mc_lqt_control in userspace memory
```
